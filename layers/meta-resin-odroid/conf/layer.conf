## layers/meta-resin-odroid/conf/layer.conf
```bitbake
BBPATH .= ":${LAYERDIR}"

BBFILES += "${LAYERDIR}/recipes-*/*/*.bb \
            ${LAYERDIR}/recipes-*/*/*.bbappend"

BBFILE_COLLECTIONS += "resin-odroid"
BBFILE_PATTERN_resin-odroid := "^${LAYERDIR}/"
BBFILE_PRIORITY_resin-odroid = "1337"

PREFERRED_VERSION_u-boot = "2018.01"
BALENA_STORAGE_odroid-c2 = "overlay2"
```
